## configs/uma7439_wpe_nf_defconfig
```kconfig
BR2_arm=y
BR2_cortex_a15=y
BR2_ARM_FPU_NEON_VFPV4=y
BR2_ARM_INSTRUCTIONS_THUMB2=y
BR2_CCACHE=y
BR2_TOOLCHAIN_EXTERNAL=y
BR2_TOOLCHAIN_EXTERNAL_CUSTOM=y
BR2_TOOLCHAIN_EXTERNAL_PATH="/opt/toolchain/uma/"
BR2_TOOLCHAIN_EXTERNAL_CUSTOM_PREFIX="arm-buildroot-linux-gnueabihf"
BR2_TOOLCHAIN_EXTERNAL_GCC_5=y
BR2_TOOLCHAIN_EXTERNAL_HEADERS_3_14=y
BR2_TOOLCHAIN_EXTERNAL_CUSTOM_GLIBC=y
BR2_TOOLCHAIN_EXTERNAL_CXX=y
BR2_PACKAGE_HOST_GDB=y
BR2_TARGET_GENERIC_HOSTNAME="uma"
BR2_TARGET_GENERIC_ISSUE="Welcome"
BR2_TARGET_GENERIC_CABUNDLE=y
BR2_TARGET_GENERIC_TIMESERVER="time.nist.gov"
BR2_ROOTFS_DEVICE_CREATION_STATIC=y
BR2_ROOTFS_POST_IMAGE_SCRIPT="board/uma/uma.sh"
BR2_PACKAGE_BUSYBOX_SMP=y
BR2_PACKAGE_FAAD2=y
BR2_PACKAGE_GSTREAMER1=y
BR2_PACKAGE_GST1_BCM=y
BR2_PACKAGE_GST1_COMMON=y
BR2_PACKAGE_NETFLIX=y
BR2_PACKAGE_NETFLIX_LIB=y
BR2_PACKAGE_GETTEXT=y
BR2_PACKAGE_NINJA=y
BR2_PACKAGE_BITSTREAM_VERA=y
BR2_PACKAGE_UMA_SDK=y
BR2_PACKAGE_ALSA_LIB=y
# BR2_PACKAGE_ALSA_LIB_ALOAD is not set
# BR2_PACKAGE_ALSA_LIB_RAWMIDI is not set
# BR2_PACKAGE_ALSA_LIB_HWDEP is not set
# BR2_PACKAGE_ALSA_LIB_ALISP is not set
# BR2_PACKAGE_ALSA_LIB_OLD_SYMBOLS is not set
BR2_PACKAGE_WPEFRAMEWORK=y
BR2_PACKAGE_WPEFRAMEWORK_PORT="8082"
BR2_PACKAGE_WPEFRAMEWORK_PERSISTENT_PATH="/hdd/metrological/persistent"
BR2_PACKAGE_WPEFRAMEWORK_DATA_PATH="/hdd/metrological/usr/share/WPEFramework"
BR2_PACKAGE_WPEFRAMEWORK_SYSTEM_PATH="/hdd/metrological/usr/lib/wpeframework/plugins"
BR2_PACKAGE_WPEFRAMEWORK_PROXYSTUB_PATH="/hdd/metrological/usr/lib/wpeframework/proxystubs"
BR2_PACKAGE_WPEFRAMEWORK_VIRTUALINPUT=y
BR2_PACKAGE_WPEFRAMEWORK_PROVISIONPROXY=y
BR2_PACKAGE_WPEFRAMEWORK_DEVICEINFO=y
BR2_PACKAGE_WPEFRAMEWORK_LOCATIONSYNC=y
BR2_PACKAGE_WPEFRAMEWORK_LOCATIONSYNC_URI="jsonip.metrological.com"
BR2_PACKAGE_WPEFRAMEWORK_MONITOR=y
BR2_PACKAGE_WPEFRAMEWORK_TIMESYNC=y
BR2_PACKAGE_WPEFRAMEWORK_REMOTECONTROL=y
BR2_PACKAGE_WPEFRAMEWORK_TRACECONTROL=y
BR2_PACKAGE_WPEFRAMEWORK_WEBKITBROWSER=y
BR2_PACKAGE_WPEFRAMEWORK_WEBKITBROWSER_CLIENTIDENTIFIER="2"
BR2_PACKAGE_WPEFRAMEWORK_WEBSERVER=y
BR2_PACKAGE_WPEFRAMEWORK_WEBSHELL=y
BR2_PACKAGE_WPEFRAMEWORK_DIALSERVER=y
BR2_PACKAGE_WPEFRAMEWORK_NETFLIX=y
BR2_PACKAGE_WPEFRAMEWORK_PROVISIONING=y
BR2_PACKAGE_WPEWEBKIT=y
# BR2_PACKAGE_WPEWEBKIT_USE_GSTREAMER_WEBKIT_HTTP_SRC is not set
BR2_PACKAGE_WPEWEBKIT_USE_PUNCH_HOLE_NONE=y
BR2_PACKAGE_LIBXKBCOMMON=y
BR2_PACKAGE_ORC=y
BR2_PACKAGE_ICU_USE_ICUDATA=y
BR2_PACKAGE_UTIL_LINUX_PIVOT_ROOT=y
```

## configs/x86_64_westeros_defconfig
```kconfig
BR2_x86_64=y
BR2_CCACHE=y
BR2_TOOLCHAIN_BUILDROOT_GLIBC=y
BR2_TOOLCHAIN_BUILDROOT_CXX=y
BR2_TARGET_GENERIC_CABUNDLE=y
BR2_TARGET_GENERIC_ROOT_PASSWD="root"
BR2_PACKAGE_GST1_COMMON=y
BR2_PACKAGE_GST1_PLUGINS_BASE_PLUGIN_APP=y
BR2_PACKAGE_GST1_PLUGINS_BASE_PLUGIN_VIDEOCONVERT=y
BR2_PACKAGE_GST1_PLUGINS_BASE_PLUGIN_GIO=y
BR2_PACKAGE_GST1_PLUGINS_BASE_PLUGIN_ALSA=y
BR2_PACKAGE_GST1_PLUGINS_GOOD=y
BR2_PACKAGE_GST1_PLUGINS_GOOD_PLUGIN_AUDIOFX=y
BR2_PACKAGE_GST1_PLUGINS_GOOD_PLUGIN_AUDIOPARSERS=y
BR2_PACKAGE_GST1_PLUGINS_GOOD_PLUGIN_AUTODETECT=y
BR2_PACKAGE_GST1_PLUGINS_GOOD_PLUGIN_DEINTERLACE=y
BR2_PACKAGE_GST1_PLUGINS_GOOD_PLUGIN_INTERLEAVE=y
BR2_PACKAGE_GST1_PLUGINS_GOOD_PLUGIN_SOUPHTTPSRC=y
BR2_PACKAGE_GST1_PLUGINS_BAD=y
BR2_PACKAGE_GST1_PLUGINS_BAD_PLUGIN_MPEGTSDEMUX=y
BR2_PACKAGE_GST1_PLUGINS_BAD_PLUGIN_VIDEOPARSERS=y
BR2_PACKAGE_GST1_PLUGINS_BAD_PLUGIN_DASH=y
BR2_PACKAGE_GST1_PLUGINS_BAD_PLUGIN_FAAD=y
BR2_PACKAGE_GST1_PLUGINS_BAD_PLUGIN_HLS=y
BR2_PACKAGE_GST1_PLUGINS_BAD_PLUGIN_SMOOTHSTREAMING=y
BR2_PACKAGE_GST1_PLUGINS_UGLY=y
BR2_PACKAGE_GST1_PLUGINS_UGLY_PLUGIN_MPG123=y
BR2_PACKAGE_MESA3D=y
BR2_PACKAGE_MESA3D_GALLIUM_DRIVER_NOUVEAU=y
BR2_PACKAGE_MESA3D_GALLIUM_DRIVER_R600=y
BR2_PACKAGE_MESA3D_GALLIUM_DRIVER_SVGA=y
BR2_PACKAGE_MESA3D_GALLIUM_DRIVER_SWRAST=y
BR2_PACKAGE_MESA3D_DRI_DRIVER_SWRAST=y
BR2_PACKAGE_MESA3D_DRI_DRIVER_I915=y
BR2_PACKAGE_MESA3D_DRI_DRIVER_I965=y
BR2_PACKAGE_MESA3D_DRI_DRIVER_NOUVEAU=y
BR2_PACKAGE_MESA3D_DRI_DRIVER_RADEON=y
BR2_PACKAGE_MESA3D_OPENGL_EGL=y
BR2_PACKAGE_MESA3D_OPENGL_ES=y
BR2_PACKAGE_WESTON_APPS=y
BR2_PACKAGE_WESTEROS_EXTENDED=y
BR2_PACKAGE_WESTEROS_APP=y
BR2_PACKAGE_WESTEROS_TEST=y
BR2_PACKAGE_WESTEROS_XDGV5_SHELL=y
BR2_PACKAGE_WESTEROS_SB_PROTOCOL=y
BR2_PACKAGE_XORG7=y
BR2_PACKAGE_XKEYBOARD_CONFIG=y
BR2_PACKAGE_LZO=y
BR2_PACKAGE_OPENSSL=y
BR2_PACKAGE_LIBXKBCOMMON=y
BR2_PACKAGE_ORC=y
BR2_PACKAGE_NCURSES=y
```

## package/WPEFramework-Open/Config.in
```kconfig
config BR2_PACKAGE_WPEFRAMEWORK_OPEN
	bool "WPEFramework Open plugins"

	help
	   Commander Plugin
if BR2_PACKAGE_WPEFRAMEWORK_OPEN

config BR2_PACKAGE_WPEFRAMEWORK_OPEN_COMMANDER
	bool "Commander"

	help
	   Commander Plugin
	   
config BR2_PACKAGE_WPEFRAMEWORK_OPEN_DEVICEINFO
	bool "DeviceInfo"

	help
	   DeviceInfo Plugin

config BR2_PACKAGE_WPEFRAMEWORK_OPEN_LOCATIONSYNC
	bool "LocationSync"

	help
	   LocationSync Plugin

config BR2_PACKAGE_WPEFRAMEWORK_OPEN_MONITOR
	bool "Monitor"

	help
	   Monitor Plugin

config BR2_PACKAGE_WPEFRAMEWORK_OPEN_REMOTECONTROL
	bool "RemoteControl"

	help
	   RemoteControl Plugin

config BR2_PACKAGE_WPEFRAMEWORK_OPEN_SNAPSHOT
	bool "Snapshot"

	help
	   Snapshot Plugin

config BR2_PACKAGE_WPEFRAMEWORK_OPEN_TIMESYNC
	bool "TimeSync"

	help
	   TimeSync Plugin

config BR2_PACKAGE_WPEFRAMEWORK_OPEN_TRACECONTROL
	bool "TraceControl"

	help
	   TraceControl Plugin

config BR2_PACKAGE_WPEFRAMEWORK_OPEN_WEBKITBROWSER
	bool "WebKitBrowser"

	help
	   WebKitBrowser Plugin

config BR2_PACKAGE_WPEFRAMEWORK_OPEN_WEBPROXY
	bool "WebProxy"

	help
	   WebProxy Plugin

config BR2_PACKAGE_WPEFRAMEWORK_OPEN_WEBSERVER
	bool "WebServer"

	help
	   WebServer Plugin

config BR2_PACKAGE_WPEFRAMEWORK_OPEN_WEBSHELL
	bool "WebShell"

	help
	   WebShell Plugin

endif
```

## package/WPEFramework/Config.in
```kconfig
menuconfig BR2_PACKAGE_WPEFRAMEWORK
	bool "WPEFramework"
	help
	   Base WPE Framework	  
	  
if BR2_PACKAGE_WPEFRAMEWORK
config BR2_PACKAGE_WPEFRAMEWORK_DEBUG
	bool "Debug"
	help
	   Allow the WPE Framework to be more verbose. All development traces
           are turned on.
           
config BR2_PACKAGE_WPEFRAMEWORK_VIRTUALINPUT
	bool "VirtualInput"
	help
	   If the dynamic uinput system can not be used for security reasons, this
           allows for relaying keys to plugins

source "package/WPEFramework/WPEFramework-Provisioning/Config.in"
source "package/WPEFramework/WPEFramework-DIALServer/Config.in"
source "package/WPEFramework/WPEFramework-Netflix/Config.in"
source "package/WPEFramework/WPEFramework-Compositor/Config.in"
source "package/WPEFramework/WPEFramework-SwitchBoard/Config.in"
source "package/WPEFramework/WPEFramework-Dictionary/Config.in"
source "package/WPEFramework/WPEFramework-Open/Config.in"
endif
```

## package/WPEFramework/WPEFramework-Compositor/Config.in
```kconfig
menuconfig BR2_PACKAGE_WPEFRAMEWORK_COMPOSITOR
	bool "WPEFramework-Compositor"

	help
	   WPE Platform Compositor plugin
```

## package/WPEFramework/WPEFramework-DeviceInfo/Config.in
```kconfig
config BR2_PACKAGE_WPEFRAMEWORK_OPEN_DEVICEINFO
	bool "DeviceInfo"
	help
	   DeviceInfo Plugin
```

## package/WPEFramework/WPEFramework-Monitor/Config.in
```kconfig
config BR2_PACKAGE_WPEFRAMEWORK_OPEN_MONITOR
	bool "Monitor"

	help
	   Monitor Plugin
```

## package/WPEFramework/WPEFramework-Netflix/Config.in
```kconfig
menuconfig BR2_PACKAGE_WPEFRAMEWORK_NETFLIX
	bool "WPEFramework-Netflix"

	help
	   WPE Platform Netflix plugin
```

## package/WPEFramework/WPEFramework-Open/Config.in
```kconfig
config BR2_PACKAGE_WPEFRAMEWORK_OPEN
	bool "WPEFramework Open plugins"

	help
	   Commander Plugin
	   
if BR2_PACKAGE_WPEFRAMEWORK_OPEN
config BR2_PACKAGE_WPEFRAMEWORK_OPEN_COMMANDER
	bool "Commander"

	help
	   Commander Plugin

menuconfig BR2_PACKAGE_WPEFRAMEWORK_OPEN_LOCATIONSYNC
	bool "LocationSync"
	help
	   LocationSync Plugin
	   WPE Platform Dictionary plugin
	   
if BR2_PACKAGE_WPEFRAMEWORK_OPEN_LOCATIONSYNC
config BR2_PACKAGE_WPEFRAMEWORK_OPEN_LOCATIONSYNC_URI
	string "location URI"
	default "location.webplatformforembedded.org"
endif	   

config BR2_PACKAGE_WPEFRAMEWORK_OPEN_TIMESYNC
	bool "TimeSync"
	help
	   TimeSync Plugin
	   
source "package/WPEFramework/WPEFramework-DeviceInfo/Config.in"
source "package/WPEFramework/WPEFramework-Monitor/Config.in"
source "package/WPEFramework/WPEFramework-RemoteControl/Config.in"
source "package/WPEFramework/WPEFramework-Snapshot/Config.in"
source "package/WPEFramework/WPEFramework-TraceControl/Config.in"
source "package/WPEFramework/WPEFramework-WebKitBrowser/Config.in"
source "package/WPEFramework/WPEFramework-WebProxy/Config.in"
source "package/WPEFramework/WPEFramework-WebServer/Config.in"

config BR2_PACKAGE_WPEFRAMEWORK_OPEN_WEBSHELL
	bool "WebShell"

	help
	   WebShell Plugin

endif
```

## package/WPEFramework/WPEFramework-Provisioning/Config.in
```kconfig
menuconfig BR2_PACKAGE_WPEFRAMEWORK_PROVISIONING
	bool "WPEFramework-Provisioning"
	select BR2_PACKAGE_LIBPROVISION
	help
	   WPE Platform Provisioning plugin
```

## package/WPEFramework/WPEFramework-RemoteControl/Config.in
```kconfig
menuconfig BR2_PACKAGE_WPEFRAMEWORK_OPEN_REMOTECONTROL
	bool "RemoteControl"
	help
	   RemoteControl Plugin

if BR2_PACKAGE_WPEFRAMEWORK_OPEN_REMOTECONTROL

config BR2_PACKAGE_WPEFRAMEWORK_OPEN_REMOTECONTROL_IR
    bool "IR (Infrared)"
    help
       Select devices which are based on Infrared (IR) technology

config BR2_PACKAGE_WPEFRAMEWORK_OPEN_REMOTECONTROL_IRNEXUS
    bool "BCM Nexus IR Remote Control Unit"
    default false
    depends on BR2_PACKAGE_BCM_REFSW && BR2_PACKAGE_WPEFRAMEWORK_OPEN_REMOTECONTROL_IR
    help
       Enable the Nexus IR remote input

config BR2_PACKAGE_WPEFRAMEWORK_OPEN_REMOTECONTROL_IRNEXUS_MODE
    string "IR mode"
    default "16"
    depends on BR2_PACKAGE_WPEFRAMEWORK_OPEN_REMOTECONTROL_IRNEXUS
    help
       Sets the IR Mode to be used with IR Nexus. Every remote has a different mode and key mapping.

config BR2_PACKAGE_WPEFRAMEWORK_OPEN_REMOTECONTROL_RF
    bool "RF (Radio Frequency)"
    help
       Select devices which are based on Radio Frequency (RF) technology

endif
```

## package/WPEFramework/WPEFramework-Snapshot/Config.in
```kconfig
config BR2_PACKAGE_WPEFRAMEWORK_OPEN_SNAPSHOT
	bool "Snapshot"

	help
	   Snapshot Plugin
```

## package/WPEFramework/WPEFramework-TraceControl/Config.in
```kconfig
config BR2_PACKAGE_WPEFRAMEWORK_OPEN_TRACECONTROL
	bool "TraceControl"

	help
	   TraceControl Plugin
```

## package/WPEFramework/WPEFramework-WebKitBrowser/Config.in
```kconfig
menuconfig BR2_PACKAGE_WPEFRAMEWORK_OPEN_WEBKITBROWSER
	bool "WebKitBrowser"
	depends on BR2_PACKAGE_WPEWEBKIT
	help
	   WebKitBrowser Plugin

if BR2_PACKAGE_WPEFRAMEWORK_OPEN_WEBKITBROWSER

config BR2_PACKAGE_WPEFRAMEWORK_PLUGIN_WEBKITBROWSER_AUTOSTART
    depends on BR2_PACKAGE_WPEFRAMEWORK_OPEN_WEBKITBROWSER
    bool "autostart"
    default y

config BR2_PACKAGE_WPEFRAMEWORK_PLUGIN_WEBKITBROWSER_STARTURL
    depends on BR2_PACKAGE_WPEFRAMEWORK_OPEN_WEBKITBROWSER
    string "start-url"
    default "about:blank"

config BR2_PACKAGE_WPEFRAMEWORK_PLUGIN_WEBKITBROWSER_USERAGENT
    depends on BR2_PACKAGE_WPEFRAMEWORK_OPEN_WEBKITBROWSER
    string "useragent"
    default "Mozilla/5.0 (Macintosh, Intel Mac OS X 10_11_4) AppleWebKit/602.1.28+ (KHTML, like Gecko) Version/9.1 Safari/601.5.17"

config BR2_PACKAGE_WPEFRAMEWORK_PLUGIN_WEBKITBROWSER_MEMORYPROFILE
    depends on BR2_PACKAGE_WPEFRAMEWORK_OPEN_WEBKITBROWSER
    string "memory-profile"
    default "128m"

config BR2_PACKAGE_WPEFRAMEWORK_PLUGIN_WEBKITBROWSER_MEMORYPRESSURE
    depends on BR2_PACKAGE_WPEFRAMEWORK_OPEN_WEBKITBROWSER
    string "memory-pressure"
    default "databaseprocess:50m,networkprocess:100m,webprocess:300m,rpcprocess:50m"

config BR2_PACKAGE_WPEFRAMEWORK_PLUGIN_WEBKITBROWSER_MEDIADISKCACHE
    depends on BR2_PACKAGE_WPEFRAMEWORK_OPEN_WEBKITBROWSER
    bool "media-disk-cache"
    default n

config BR2_PACKAGE_WPEFRAMEWORK_PLUGIN_WEBKITBROWSER_DISKCACHE
    depends on BR2_PACKAGE_WPEFRAMEWORK_OPEN_WEBKITBROWSER
    string "disk-cache"
    default "0"

config BR2_PACKAGE_WPEFRAMEWORK_PLUGIN_WEBKITBROWSER_XHRCACHE
    depends on BR2_PACKAGE_WPEFRAMEWORK_OPEN_WEBKITBROWSER
    bool "xhr-cache"
    default false

config BR2_PACKAGE_WPEFRAMEWORK_PLUGIN_WEBKITBROWSER_TRANSPARENT
    depends on BR2_PACKAGE_WPEFRAMEWORK_OPEN_WEBKITBROWSER
    bool "transparent"
    default false

config BR2_PACKAGE_WPEFRAMEWORK_PLUGIN_YOUTUBE
    bool "youtube"
    depends on BR2_PACKAGE_WPEFRAMEWORK_OPEN_WEBKITBROWSER
    help
      A wrapper around the youtube app to start it as a
      wpeframework plugin.

endif
```

## package/WPEFramework/WPEFramework-WebProxy/Config.in
```kconfig
config BR2_PACKAGE_WPEFRAMEWORK_OPEN_WEBPROXY
	bool "WebProxy"

	help
	   WebProxy Plugin
```

## package/WPEFramework/WPEFramework-WebServer/Config.in
```kconfig
config BR2_PACKAGE_WPEFRAMEWORK_OPEN_WEBSERVER
	bool "WebServer"

	help
	   WebServer Plugin
```

## package/cobalt/Config.in
```kconfig
config BR2_PACKAGE_COBALT
        bool "cobalt"
	select BR2_PACKAGE_FFMPEG
	select BR2_PACKAGE_FFMPEG_AVRESAMPLE
```

## package/kylin-gstreamer1/Config.in
```kconfig
# Gstreamer 1.x & Plugins
source "package/kylin-gstreamer1/kylin-gstreamer1/Config.in"

if BR2_PACKAGE_KYLIN_GSTREAMER1
source "package/kylin-gstreamer1/kylin-gst1-plugins-base/Config.in"
source "package/kylin-gstreamer1/kylin-gst1-plugins-good/Config.in"
source "package/kylin-gstreamer1/kylin-gst1-plugins-bad/Config.in"
source "package/kylin-gstreamer1/kylin-gst1-plugins-ugly/Config.in"
source "package/kylin-gstreamer1/kylin-gst1-imx/Config.in"
source "package/kylin-gstreamer1/kylin-gst1-libav/Config.in"
source "package/kylin-gstreamer1/kylin-gst1-rtsp-server/Config.in"
source "package/kylin-gstreamer1/kylin-gst1-validate/Config.in"
source "package/kylin-gstreamer1/kylin-gst-omx/Config.in"
source "package/kylin-gstreamer1/kylin-gst-rtkv1sink/Config.in"
endif
```

## package/kylin-gstreamer1/kylin-gst-omx/Config.in
```kconfig
config BR2_PACKAGE_KYLIN_GST_OMX
	bool "kylin-gst-omx"
	depends on BR2_PACKAGE_HAS_LIBOPENMAX
	depends on !BR2_PACKAGE_KYLIN_HARDWARE || (BR2_PACKAGE_KYLIN_HARDWARE && BR2_PACKAGE_KYLIN_PLATFORM_LIB)
	select BR2_PACKAGE_KYLIN_GST1_PLUGINS_BASE
	help
	  GStreamer plug-in to use OpenMAX API.

	  http://cgit.freedesktop.org/gstreamer/gst-omx


comment "kylin-gst-omx requires a OpenMAX implementation"
	depends on !BR2_PACKAGE_HAS_LIBOPENMAX

comment "kylin-gst-omx requires a Kylin platform for Kylin build"
	depends on BR2_PACKAGE_KYLIN_HARDWARE && !BR2_PACKAGE_KYLIN_PLATFORM_LIB
```
