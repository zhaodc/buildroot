## package/kylin/Config.in
```kconfig
menuconfig BR2_PACKAGE_KYLIN_HARDWARE
	bool "kylin"
	help
	  All platform related packages for Realtek Kylin
	  
if BR2_PACKAGE_KYLIN_HARDWARE
	choice
		prompt "Kernel version"
		default BR2_PACKAGE_KYLIN_KERNEL_4_1_17
		help
		  Select the kernel version of the kylin platform
		  
		config BR2_PACKAGE_KYLIN_KERNEL_4_1_17
			bool "4.1.17"
			help
			  Needed if platform has a Linux kernel v4.1.17
			  
		config BR2_PACKAGE_KYLIN_KERNEL_4_1_35
			bool "4.1.35"
			help
			  Needed if platform has a Linux kernel v4.1.35 
	endchoice

	source "package/kylin/kylin-omx/Config.in"
	source "package/kylin/kylin-gst-omx/Config.in"
	source "package/kylin/kylin-gst-rtkv1sink/Config.in"
	source "package/kylin/kylin-platform-lib/Config.in"
	if !BR2_PACKAGE_KYLIN_PLATFORM_BIN_KO
	source "package/kylin/kylin-drivers/Config.in"
	endif
	source "package/kylin/kylin-graphics/Config.in"
	source "package/kylin/kylin-weston/Config.in"
	source "package/kylin/kylin-tools/Config.in"
endif

config BR2_PACKAGE_HAS_KYLIN
	bool

config BR2_PACKAGE_PROVIDES_KYLIN
	depends on BR2_PACKAGE_HAS_KYLIN
	string
```

## package/kylin/kylin-apps/Config.in
```kconfig
config BR2_PACKAGE_KYLIN_APPS
	depends on BR2_PACKAGE_KYLIN_PLATFORM_LIB
	bool "kylin-apps"
	help
	  Kylin apps are some convenience and testing apps for the Kylin platform.

if BR2_PACKAGE_KYLIN_APPS	

config BR2_PACKAGE_KYLIN_SIMPLE_APP
	bool "kylin-simple-app"
	depends on BR2_PACKAGE_KYLIN_GRAPHICS
	depends on BR2_PACKAGE_KYLIN_PLATFORM_LIB
	help
	  Simple kylin app.

config BR2_PACKAGE_KYLIN_HDMI_INFO
	bool "kylin-hdmi-info"
	depends on BR2_PACKAGE_KYLIN_GRAPHICS
	depends on BR2_PACKAGE_KYLIN_PLATFORM_LIB
	help
	  Display kylin HDMI info.

config BR2_PACKAGE_KYLIN_HDMI_MODESET
	bool "kylin-hdmi-modeset"
	depends on BR2_PACKAGE_KYLIN_GRAPHICS
	depends on BR2_PACKAGE_KYLIN_PLATFORM_LIB
	help
	  Set kylin HDMI mode.

config BR2_PACKAGE_KYLIN_VIDEO_INFO
	bool "kylin-video-info"
	depends on BR2_PACKAGE_KYLIN_GRAPHICS
	depends on BR2_PACKAGE_KYLIN_PLATFORM_LIB
	help
	  Display kylin video info.

endif

comment "kylin-apps requires kylin-platform-lib"
	depends on !BR2_PACKAGE_KYLIN_PLATFORM_LIB
```

## package/kylin/kylin-drivers/Config.in
```kconfig
config BR2_PACKAGE_KYLIN_DRIVERS
	bool "drivers"
	help
         kylin platform drivers.

if BR2_PACKAGE_KYLIN_DRIVERS

config BR2_PACKAGE_KYLIN_DRIVERS_BLUETOOTH
	bool "Bluetooth driver"
	help
         Install bluetooth kernel module
         
config BR2_PACKAGE_KYLIN_DRIVERS_MALI
	bool "Mali driver"
	help
         Install mali kernel module
         
config BR2_PACKAGE_KYLIN_DRIVERS_RF4CE
	bool "RF4CE driver"
	help
         Install greenpeak rf4ce kernel module

config BR2_PACKAGE_KYLIN_DRIVERS_WIFI
	bool "WiFi drivers"
	help
         Install WiFi kernel module	
         
config BR2_PACKAGE_KYLIN_DRIVERS_PARAGON
	bool "Paragon driver"
	help
         Install WiFi Paragon module	
         
config BR2_PACKAGE_KYLIN_DRIVERS_REALTEK
	bool "Realtek driver"
	help
         Install Realtek driver

config BR2_PACKAGE_KYLIN_DRIVERS_AUDIO
	bool "Realtek audio core"
	help
         Install Realtek audio core
endif
```

## package/kylin/kylin-gst-rtkv1sink/Config.in
```kconfig
config BR2_PACKAGE_KYLIN_GST_RTKV1SINK
	bool "gst-rtkv1sink"
	depends on BR2_PACKAGE_KYLIN_PLATFORM_LIB
	depends on BR2_PACKAGE_KYLIN_GST_OMX
	help
		Realtek GStreamer Video Sink gst-rtkv1sink

comment "gst-rtkv1sink requires Realtek Kylin"
	depends on !BR2_PACKAGE_KYLIN_PLATFORM_LIB

comment "gst-rtkv1sink requires gst-omx"
	depends on !BR2_PACKAGE_KYLIN_GST_OMX
```

## package/kylin/kylin-omx/Config.in
```kconfig
config BR2_PACKAGE_KYLIN_OMX
	bool "kylin-omx"
	depends on (BR2_arm && BR2_ARM_EABIHF) || BR2_aarch64
	depends on BR2_TOOLCHAIN_HAS_THREADS
	select BR2_PACKAGE_HAS_LIBOPENMAX
	help
	  OpenMAX libraries for RTD1195.

if BR2_PACKAGE_KYLIN_OMX

config BR2_PACKAGE_PROVIDES_LIBOPENMAX
	default "kylin-omx"

endif
```

## package/kylin/kylin-platform-lib/Config.in
```kconfig
menuconfig BR2_PACKAGE_KYLIN_PLATFORM_LIB
	bool "Platform Options"
	depends on (BR2_arm && BR2_ARM_EABIHF) || BR2_aarch64
	depends on BR2_TOOLCHAIN_HAS_THREADS
	select BR2_PACKAGE_HAS_LIBOPENMAX
	select BR2_PACKAGE_HAS_KYLIN
	help
         Realtek Kylin hardware options
	
if BR2_PACKAGE_KYLIN_PLATFORM_LIB

config BR2_PACKAGE_KYLIN_PLATFORM_BIN_KO
	bool "Precomplied kernel modules"
	help
         Install precomplied kernel modules
         
config KYLIN_PLATFORM_LIB_INSTALL_BINARIES
	bool "Misc Binaries"
	help
         Install a bunch of realtek provided binaries

config BR2_PACKAGE_PROVIDES_KYLIN
	default "kylin-platform-lib"
	
config BR2_PACKAGE_PROVIDES_LIBOPENMAX
	default "kylin-platform-lib"
	
endif
	
```

## package/kylin/kylin-tools/Config.in
```kconfig
menuconfig BR2_PACKAGE_KYLIN_TOOLS
	bool "Platform Tools"
	help
         Realtek Kylin hardware options
         
if BR2_PACKAGE_KYLIN_TOOLS

config BR2_PACKAGE_KYLIN_TOOLS_DISPLAY
	bool "display"
	help
         Install a tool to controll the HDMI
endif
	
```

## package/libcurl/Config.in
```kconfig
config BR2_PACKAGE_LIBCURL
	bool "libcurl"
	help
	  cURL is a tool for getting files from FTP, HTTP, Gopher, Telnet,
	  and Dict servers, using any of the supported protocols.

	  http://curl.haxx.se/

if BR2_PACKAGE_LIBCURL

choice
	prompt "Libcurl version to use"
	default BR2_PACKAGE_LIBCURL_7_53_1
	config BR2_PACKAGE_LIBCURL_7_53_1
	bool "7.53.1"
	config BR2_PACKAGE_LIBCURL_7_32_0
	bool "7.32.0"
endchoice

config BR2_PACKAGE_LIBCURL_AT_LEAST_7_53_1
	default y if BR2_PACKAGE_LIBCURL_7_53_1
	default n
	select BR2_PACKAGE_LIBCURL_AT_LEAST_7_32_0
	bool

config BR2_PACKAGE_LIBCURL_AT_LEAST_7_32_0
	default y if BR2_PACKAGE_LIBCURL_7_32_0
	default n
	bool

config BR2_PACKAGE_LIBCURL_VERSION_STRING
	string
	default "7.53.1" if BR2_PACKAGE_LIBCURL_AT_LEAST_7_53_1
	default "7.32.0" if BR2_PACKAGE_LIBCURL_AT_LEAST_7_32_0
	default "Version not set"

config BR2_PACKAGE_CURL
	bool "curl binary"
	help
	  Install curl binary as well

config BR2_PACKAGE_LIBCURL_VERBOSE
	bool "enable verbose strings"
	help
	  Enable verbose text strings

endif
```

## package/weston-apps/Config.in
```kconfig
comment "Weston-apps is only supporting Linux desktop configurations (x86_64), Raspberry pi, and Kylin platforms."
	depends on !BR2_x86_64 && !BR2_PACKAGE_HAS_KYLIN && !BR2_PACKAGE_RPI_USERLAND

config BR2_PACKAGE_WESTON_APPS
	bool "weston-apps"
	help
	  Weston apps are some convenience and testing apps for Weston.

if BR2_PACKAGE_WESTON_APPS	

comment "westeros needs XORG7 when building for X86_64"
	depends on BR2_x86_64 && !BR2_PACKAGE_XORG7

config BR2_PACKAGE_WESTEROS_EXTENDED
	bool "westeros"
	select BR2_PACKAGE_WAYLAND
	select BR2_PACKAGE_WAYLAND_PROTOCOLS
	select BR2_PACKAGE_GSTREAMER1
	select BR2_PACKAGE_GST1_PLUGINS_BASE
	help
	  Westeros implementation with support for Linux desktop x86_64, raspberry pi 3 and Kylin.

if BR2_PACKAGE_WESTEROS_EXTENDED

config BR2_PACKAGE_WESTEROS_APP
	bool "westeros application"
	help
	  Westeros main application.

config BR2_PACKAGE_WESTEROS_PLAYER
	bool "westeros player"
	help
	  Westeros GStreamer player.

config BR2_PACKAGE_WESTEROS_TEST
	bool "westeros test"
	help
	  Westeros test application.

comment "Only XDG V4 or V5 shell can be selected, not both"
	depends on BR2_PACKAGE_WESTEROS_XDGV4_SHELL && BR2_PACKAGE_WESTEROS_XDGV5_SHELL

config BR2_PACKAGE_WESTEROS_XDGV4_SHELL
	bool "westeros using XDGV4 shell"
	help
	  Westeros XDGV4 shell.

config BR2_PACKAGE_WESTEROS_XDGV5_SHELL
	bool "westeros using XDGV5 shell"
	help
	  Westeros XDGV5 shell.

config BR2_PACKAGE_WESTEROS_SB_PROTOCOL
	bool "westeros using simplebuffer protocol"
	help
	  Westeros simplebuffer protocol.

endif

endif
```

## package/wpe/wpeframework-domotica/Config.in
```kconfig
menuconfig BR2_PACKAGE_WPEFRAMEWORK_DOMOTICA
	bool "Domotica"
	help 
	  Plugins facilitating home-automation

if BR2_PACKAGE_WPEFRAMEWORK_DOMOTICA

config BR2_PACKAGE_WPEFRAMEWORK_DICTIONARY
	bool "Dictionary"
	help
	   Dictionary Plugin, The bookkeeper that translates all technical IElement names to Human Readable names.

config BR2_PACKAGE_WPEFRAMEWORK_BUTLER
	bool "Butler"
	help
	   Bulter Plugin, create logic for all information coming in, via IElement interfaces, to set IElement interfaces.

config BR2_PACKAGE_WPEFRAMEWORK_BARN
	bool "Barn"
	help
	   Barn Plugin, dedicated logic to control RPI pins directly, including the business logic.

config BR2_PACKAGE_WPEFRAMEWORK_IOCONTROL
	bool "IOControl"
	help
	   (G)PIO Control Plugin
	   Expose the RaspberryPi GPIO port as IElement interfaces

config BR2_PACKAGE_WPEFRAMEWORK_TEMPCONTROL
	bool "TempControl"
	help
	   Temperature Control Plugin
	   Expose the Dallas 1-Wire DS1820 as IElement interface

config BR2_PACKAGE_WPEFRAMEWORK_ZWAVECONTROL
	bool "ZWaveControl"
	help
	   ZWave Control Plugin
	   Expose ZWave enabled modules as IElement interfaces

endif
```
